## dts/bindings/behaviors/zmk,behavior-switch-keymap.yaml
```yaml
description: Switch between keymaps in runtime
compatible: "zmk,behavior-switch-keymap"
include: one_param.yaml

properties:
  feedback-duration:
    type: int
    default: 0
```

## src/Kconfig
```kconfig
if SHELL

config ZMK_KEYMAP_SHELL
bool "Keymap shell commands"
default y

config ZMK_KEYMAP_SHELL_SLOTS
int "Maximum stored keymaps"
default 4

endif
```

## src/output_keymap/Kconfig
```kconfig
config ZMK_KEYMAP_OUTPUT_ASSIGN
	bool "Auto-activate keymap slots per output (USB/BLE profile)"
	default y
	depends on ZMK_KEYMAP_SHELL && ZMK_KEYMAP_SETTINGS_STORAGE && ZMK_BLE

config ZMK_KEYMAP_OUTPUT_ASSIGN_BOOT_DELAY_MS
	int "Delay before syncing the current output at boot (ms)"
	default 2000
	depends on ZMK_KEYMAP_OUTPUT_ASSIGN
```

## src/shell/Kconfig
```kconfig
if SHELL

config ZMK_KEYMAP_SHELL
bool "Keymap shell commands"
default y

config ZMK_KEYMAP_SHELL_SLOTS
int "Maximum stored keymaps"
default 4

config ZMK_KEYMAP_SHELL_SLOT_NAME_MAX
int "Maximum slot name length (including terminator)"
default 24

endif
```
